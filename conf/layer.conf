## conf/layer.conf
```bitbake
#
# Copyright (C) 2013 Wind River Systems, Inc.
#

# We have a conf and classes directory, add to BBPATH
BBPATH =. "${LAYERDIR}:"

# We have a packages directory, add to BBFILES
BBFILES += "${LAYERDIR}/recipes-*/*/*.bb \
	${LAYERDIR}/meta-virtualization/recipes*/*/*.bb \
	${LAYERDIR}/meta-virtualization/recipes*/*/*.bbappend \
	${LAYERDIR}/meta-realtime/recipes*/*/*.bb \
	${LAYERDIR}/meta-realtime/recipes*/*/*.bbappend \
	${LAYERDIR}/recipes-*/*/*.bbappend"

BBFILE_COLLECTIONS += "wr-kernel"
BBFILE_PATTERN_wr-kernel = "^${LAYERDIR}/"
BBFILE_PRIORITY_wr-kernel = "6"

BBMASK ?= "/(linux-yocto)"

PREFERRED_PROVIDER_virtual/kernel = "linux-windriver"

# This should only be incremented on significant changes that will
# cause compatibility issues with other layers
LAYERVERSION_wr-kernel = "1"

LAYERDEPENDS_wr-kernel = "core wr-userspace-base networking-layer"

require wr-kernel_blacklist.conf
```

## conf/machine/qemuarm.conf
```bitbake
#@TYPE: Machine
#@NAME: qemu emulated arm_versatile_926ejs
#@DESCRIPTION: qemu emulated arm_versatile_926ejs

require qemuarm.inc
require ${COREBASE}/meta/conf/machine/qemuarm.conf
```

## conf/machine/qemuarm.inc
```bitbake
#
# Copyright (C) 2015 Wind River Systems, Inc. 
#

PCMCIA_MANAGER = "pcmciautils"

MACHINE_FEATURES = "alsa pcmcia bluetooth irda usbgadget screen"

IMAGE_FSTYPES += "tar.bz2"

ROOT_FLASH_SIZE = "280"

# Don't include kernels in standard images
RDEPENDS_kernel-base = ""

PREFERRED_VERSION_linux-windriver ?= "4.8%"
```

## conf/machine/qemuarm64.conf
```bitbake
#@TYPE: Machine
#@NAME: qemu emulated generic armv8 machine
#@DESCRIPTION: Machine configuration for running a generic armv8

require ${COREBASE}/meta/conf/machine/qemuarm64.conf
```

## conf/machine/qemuarm64.inc
```bitbake
TARGET_QEMU_BIN="qemu-system-aarch64"
TARGET_QEMU_OPTS="-machine virt -cpu cortex-a57"
TARGET_QEMU_MEM="128"
TARGET_QEMU_KERNEL="Image"
TARGET_QEMU_BOOT_CONSOLE="ttyAMA0,38400"
```

## conf/machine/qemuarma9.conf
```bitbake
#@TYPE: Machine
#@NAME: qemu emulated arm_versatile_926ejs (armv7at)
#@DESCRIPTION: arm_versatile_926ejs

require qemuarma9.inc
require conf/machine/include/qemu.inc
DEFAULTTUNE ?= "armv7at"
require conf/machine/include/tune-cortexa9.inc

KERNEL_IMAGETYPE = "zImage"

SERIAL_CONSOLE = "115200 ttyAMA0"

# Set image size for MMC disk
IMAGE_ROOTFS_EXTRA_SPACE = "0"
IMAGE_ROOTFS_SIZE = "3801088"
IMAGE_ROOTFS_ALIGNMENT = "1"

CRIU_BUILD_ARCH = "armv7"

# For runqemu
QB_SYSTEM_NAME = "qemu-system-arm"
QB_MACHINE = "-machine vexpress-a9"
QB_KERNEL_CMDLINE_APPEND = "console=ttyAMA0,115200 console=tty"
# vexpress does not have any PCI bus to support virtio-rng-pci,
# We define specific virtio block device for it.
QB_ROOTFS_OPT = "-drive id=disk0,file=@ROOTFS@,if=none,format=raw -device virtio-blk-device,drive=disk0"
QB_TAP_OPT = "-netdev tap,id=net0,ifname=@TAP@,script=no,downscript=no -device virtio-net-device,netdev=net0,mac=@MAC@"
QB_SLIRP_OPT = "-netdev user,id=net0 -device virtio-net-device,netdev=net0"
QB_OPT_APPEND = "-show-cursor"
QB_DTB = "zImage-vexpress-v2p-ca9.dtb"
```

## conf/machine/qemuarma9.inc
```bitbake
#
# Copyright (C) 2013 - 2016 Wind River Systems, Inc.
#
PCMCIA_MANAGER = "pcmciautils"
PREFERRED_PROVIDER_virtual/xserver ?= "xserver-kdrive"
PREFERRED_PROVIDER_virtual/libgl ?= "mesa"

MACHINE_FEATURES = "alsa pcmcia bluetooth irda usbgadget screen"

IMAGE_FSTYPES += "tar.bz2"

ROOT_FLASH_SIZE = "280"

# Don't include kernels in standard images
RDEPENDS_kernel-base = ""

PREFERRED_VERSION_linux-windriver ?= "4.8%"
```

## conf/machine/qemumips.conf
```bitbake
#@TYPE: Machine
#@NAME: qemu emulated mti_malta32_be MIPS
#@DESCRIPTION: qemu emulated mti_malta32_be

require qemumips.inc
require ${COREBASE}/meta/conf/machine/qemumips.conf
```

## conf/machine/qemumips.inc
```bitbake
#
# Copyright (C) 2015 Wind River Systems, Inc.
#

PCMCIA_MANAGER = "pcmciautils"

MACHINE_FEATURES = "alsa pcmcia bluetooth irda usbgadget screen"

IMAGE_FSTYPES += "tar.bz2"

ROOT_FLASH_SIZE = "280"

# Don't include kernels in standard images
RDEPENDS_kernel-base = ""

# Use a common kernel recipe for all QEMU machines
PREFERRED_PROVIDER_virtual/kernel ?= "linux-windriver"
PREFERRED_VERSION_linux-windriver ?= "4.8%"

TARGET_QEMU_BIN="qemu-system-mips"
TARGET_QEMU_OPTS="-M malta -bios mips_bios.bin"
TARGET_QEMU_KERNEL="vmlinux"
TARGET_QEMU_CPU="24Kf"
TARGET_QEMU_MEM="128"
TARGET_QEMU_KERNEL_OPTS=" oprofile.timer=1"
TARGET_QEMU_BOOT_CONSOLE="ttyS0,115200"
TARGET_QEMU_ENET_MODEL="virtio"
```

## conf/machine/qemumips64.conf
```bitbake
#@TYPE: Machine
#@NAME: qemu emulated mti-malta64-be MIPS64
#@DESCRIPTION: qemu emulated mti-malta64-be

# Compatibility name for the old way of doing this...
require qemumips64.inc
require ${COREBASE}/meta/conf/machine/qemumips64.conf
```

## conf/machine/qemumips64.inc
```bitbake
#
# Copyright (C) 2015 Wind River Systems, Inc.
#

PCMCIA_MANAGER = "pcmciautils"

MACHINE_FEATURES = "alsa pcmcia bluetooth irda usbgadget screen"

IMAGE_FSTYPES += "tar.bz2"

ROOT_FLASH_SIZE = "280"

# Don't include kernels in standard images
RDEPENDS_kernel-base = ""

PREFERRED_VERSION_linux-windriver ?= "4.8%"

QB_OPT_APPEND_append = " -bios mips_bios.bin"
QB_CPU = "-cpu MIPS64R2-generic"
QB_KERNEL_CMDLINE_APPEND_append = " oprofile.timer=1"
```

## conf/machine/qemumips64el.conf
```bitbake
#@TYPE: Machine
#@NAME: qemu emulated mti-malta64-le MIPS64
#@DESCRIPTION: qemu emulated mti-malta64-le

DEFAULTTUNE ?= "mips64el"

# Compatibility name for the old way of doing this...
require qemumips64.inc
require ${COREBASE}/meta/conf/machine/qemumips64.conf

KERNEL_FEATURES_append_${MACHINE} = " cfg/mips64le.scc"
TARGET_QEMU_CPU = "MIPS64R2-generic"
TARGET_QEMU_BIN = "qemu-system-mips64el"

KMACHINE_${MACHINE} = "mti-malta64-le"
```

## conf/machine/qemumipsel.conf
```bitbake
#@TYPE: Machine
#@NAME: qemu emulated mti_malta32_le MIPS
#@DESCRIPTION: qemu emulated mti_malta32_le

DEFAULTTUNE ?= "mips32el"

require qemumips.inc
require ${COREBASE}/meta/conf/machine/qemumips.conf

TARGET_QEMU_BIN = "qemu-system-mipsel"

KMACHINE_qemumips = "mti-malta32-le"
```

## conf/machine/qemuppc.conf
```bitbake
#@TYPE: Machine
#@NAME: qemu PPC Emulator setup
#@DESCRIPTION: Machine configuration for running an PPC system under qemu emulation

require qemuppc.inc
require ${COREBASE}/meta/conf/machine/qemuppc.conf
```

## conf/machine/qemuppc.inc
```bitbake
#
# Copyright (C) 2013 Wind River Systems, Inc.
#

PCMCIA_MANAGER = "pcmciautils"

MACHINE_FEATURES = "alsa pcmcia bluetooth irda usbgadget screen"

IMAGE_FSTYPES += "tar.bz2"

ROOT_FLASH_SIZE = "280"

# Don't include kernels in standard images
RDEPENDS_kernel-base = ""

PREFERRED_VERSION_linux-windriver ?= "4.8%"

USE_SDK_GLIBC = "0"

QB_KERNEL_CMDLINE_APPEND = "console=ttyS0,115200 oprofile.timer=1"
```

## conf/machine/qemux86-64.inc
```bitbake
PCMCIA_MANAGER = "pcmciautils"

MACHINE_FEATURES = "alsa pcmcia bluetooth irda usbgadget screen"

IMAGE_FSTYPES += "tar.bz2"

KERNEL_FEATURES += "${@bb.utils.contains('IMAGE_FSTYPES', 'live', 'cfg/boot-live.scc', '', d)}"

ROOT_FLASH_SIZE = "280"

# Don't include kernels in standard images
RDEPENDS_kernel-base = ""

PREFERRED_VERSION_linux-windriver ?= "4.8%"

# multilib support
MULTILIBS ?= "multilib:lib32"
DEFAULTTUNE_virtclass-multilib-lib32 ?= "x86"

KARCH = "x86-64"

QB_KERNEL_CMDLINE_APPEND_append = " clocksource=pit console=ttyS0,115200"

IMAGE_FSTYPES += "wic wic.bmap"
WKS_FILE ?= "directdisk.wks"
do_image_wic[depends] += "syslinux:do_build syslinux-native:do_populate_sysroot mtools-native:do_populate_sysroot dosfstools-native:do_populate_sysroot"
```

## conf/machine/qemux86.conf
```bitbake
#@TYPE: Machine
#@NAME: qemu emulated common_pc
#@DESCRIPTION: Machine configuration for running a common x86

require qemux86.inc
require ${COREBASE}/meta/conf/machine/qemux86.conf
```

## conf/machine/qemux86.inc
```bitbake
PCMCIA_MANAGER = "pcmciautils"

MACHINE_FEATURES = "alsa pcmcia bluetooth irda usbgadget screen"

IMAGE_FSTYPES += "tar.bz2"

KERNEL_FEATURES += "${@bb.utils.contains('IMAGE_FSTYPES', 'live', 'cfg/boot-live.scc', '', d)}"

ROOT_FLASH_SIZE = "280"

# Don't include kernels in standard images
RDEPENDS_kernel-base = ""

PREFERRED_VERSION_linux-windriver ?= "4.8%"

QB_KERNEL_CMDLINE_APPEND_append = " clocksource=pit console=ttyS0,115200"
```

## kernel-dev/conf/layer.conf
```bitbake
#
# Copyright (C) 2013 Wind River Systems, Inc.
#

# We have a conf and classes directory, add to BBPATH
BBPATH =. "${LAYERDIR}:"

# We have a packages directory, add to BBFILES
BBFILES += "${LAYERDIR}/recipes-*/*/*.bb \
        ${LAYERDIR}/recipes-*/*/*.bbappend"

BBFILE_COLLECTIONS += "wr-kernel-dev"
BBFILE_PATTERN_wr-kernel-dev = "^${LAYERDIR}/"
BBFILE_PRIORITY_wr-kernel-dev = "6"

BB_ENV_EXTRAWHITE += "KSRC"

# This should only be incremented on significant changes that will
# cause compatibility issues with other layers
LAYERVERSION_wr-kernel-dev = "1"

LAYERDEPENDS_wr-kernel-dev = "core wr-kernel"
```

## meta-realtime/conf/layer.conf
```bitbake
# We have a conf and classes directory, append to BBPATH
BBPATH .= ":${LAYERDIR}"

BBFILE_COLLECTIONS += "realtime"
BBFILE_PATTERN_realtime = "^${LAYERDIR}/"

# Replace ourselves with the standalone meta-realtime
INHERIT += "update-bblayers"
```

## meta-virtualization/conf/layer.conf
```bitbake
# We have a conf and classes directory, append to BBPATH
BBPATH .= ":${LAYERDIR}"

BBFILE_COLLECTIONS += "virtualization-layer"
BBFILE_PATTERN_virtualization-layer = "^${LAYERDIR}/"

# Replace ourselves with the standalone meta-virtualization
INHERIT += "update-bblayers"
```
